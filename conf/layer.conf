## conf/layer.conf
```bitbake
# We have a conf and classes directory, add to BBPATH
BBPATH .= ":${LAYERDIR}"

# We have recipes-* directories, add to BBFILES
BBFILES += "${LAYERDIR}/recipes-*/*/*.bb \
	${LAYERDIR}/recipes-*/*/*.bbappend"

BBFILE_COLLECTIONS += "strim-tech"
BBFILE_PATTERN_strim-tech = "^${LAYERDIR}/"
BBFILE_PRIORITY_strim-tech = "6"
```

## conf/machine/marsboard.conf
```bitbake
#@TYPE: Machine
#@NAME: i.MX6 MarS Board
#@DESCRIPTION: Machine configuration for i.MX6 MarS Board

include conf/machine/include/imx-base.inc
include conf/machine/include/tune-cortexa9.inc

SOC_FAMILY = "mx6:mx6d:marsboard"

PREFERRED_PROVIDER_virtual/kernel = "linux-marsboard"
PREFERRED_PROVIDER_u-boot = "u-boot-mars"

UBOOT_MACHINE = "mx6q_marsboard_config"
UBOOT_MAKE_TARGET = "u-boot.bin"
UBOOT_SUFFIX = "bin"

SERIAL_CONSOLE = "115200 ttymxc0"

MACHINE_FEATURES = ""

MACHINE_EXTRA_RRECOMMENDS += ""
```
